/* Linker template for the STM32U585 dual-bank staging app.
 * @FLASH_ORIGIN@ is WOLFBOOT_PARTITION_BOOT_ADDRESS + IMAGE_HEADER_SIZE,
 * @FLASH_SIZE@ is WOLFBOOT_PARTITION_SIZE - IMAGE_HEADER_SIZE. */
MEMORY
{
    FLASH (rx)  : ORIGIN = @FLASH_ORIGIN@, LENGTH = @FLASH_SIZE@
    RAM   (rwx) : ORIGIN = 0x20000000, LENGTH = 0x00030000
}

_estack = ORIGIN(RAM) + LENGTH(RAM) - 16;

SECTIONS
{
    .text :
    {
        KEEP(*(.isr_vector))
        *(.text*)
        *(.rodata*)
    } > FLASH
}
